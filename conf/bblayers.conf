## conf/bblayers.conf
```bitbake
# LAYER_CONF_VERSION is increased each time build/conf/bblayers.conf
# changes incompatibly
LCONF_VERSION = "6"

TOPDIR := "${@os.path.dirname(os.path.dirname(d.getVar('FILE', True)))}"
BBPATH = "${TOPDIR}"

BBFILES ?= ""

BBLAYERS ?= " \
  ${TOPDIR}/sources/poky/meta \
  ${TOPDIR}/sources/poky/meta-yocto \
  ${TOPDIR}/sources/poky/meta-yocto-bsp \
  ${TOPDIR}/sources/meta-stlinux \
  ${TOPDIR}/sources/meta-magpie \
  ${TOPDIR}/sources/meta-neutrino-mp \
  ${TOPDIR}/sources/meta-local \
  ${TOPDIR}/sources/meta-openpli \
  ${TOPDIR}/sources/meta-oe/meta-oe \
  ${TOPDIR}/sources/meta-oe/meta-networking \
  ${TOPDIR}/sources/meta-oe/meta-multimedia \
  ${TOPDIR}/sources/meta-oe/meta-filesystems \
  "
```
